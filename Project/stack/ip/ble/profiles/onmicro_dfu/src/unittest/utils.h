#ifndef __UTILS_H__
#define __UTILS_H__

#include <stdio.h>
#include <stdint.h>
#include <stdlib.h>
#include <string.h>

#undef log_debug
#define log_debug printf
#define hexdump(d,l) do{int i; for(i=0;i<l;i++)log_debug("%02X ", ((uint8_t*)d)[i]);log_debug("\n");}while(0)

static const uint16_t crc16tab[256] =
{
    0x0000,0x1021,0x2042,0x3063,0x4084,0x50a5,0x60c6,0x70e7,
    0x8108,0x9129,0xa14a,0xb16b,0xc18c,0xd1ad,0xe1ce,0xf1ef,
    0x1231,0x0210,0x3273,0x2252,0x52b5,0x4294,0x72f7,0x62d6,
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    0x6e17,0x7e36,0x4e55,0x5e74,0x2e93,0x3eb2,0x0ed1,0x1ef0
};

uint16_t co_crc16_ccitt(uint16_t crcinit, const void *buf, unsigned len)
{
    register unsigned counter;
    register uint16_t crc = crcinit;
    const uint8_t *__buf = buf;

    for( counter = 0; counter < len; counter++)
        crc = (crc<<8) ^ crc16tab[((crc>>8) ^ *(uint8_t *)__buf++) & 0x00FF];
    return crc;
}

static  uint32_t dfu_crc32(uint8_t const * p_data, uint32_t size, uint32_t const * p_crc)
{
    uint32_t crc;
    crc = (p_crc == NULL) ? 0xFFFFFFFF : ~(*p_crc);
    for (uint32_t i = 0; i < size; i++){
        crc = crc ^ p_data[i];
        for (uint32_t j = 8; j > 0; j--) crc = (crc >> 1) ^ (0xEDB88320U & ((crc & 1) ? 0xFFFFFFFF : 0));
    }
    return ~crc;
}


static void dfu_start_cb(uint8_t status, void *p)
{
    log_debug("%s@%d\n", __func__, __LINE__);
}
static void dfu_prog_cb(uint8_t status, void *p)
{
    //log_debug("%s@%d\n", __func__, __LINE__);
}
static void dfu_end_cb(uint8_t status, void *p)
{
    assert(status == DFU_UPDATE_ST_SUCCESS);
    log_debug("%s status:%d\n", __func__, status);
}

static dfu_response_t test_write_cmd(uint8_t *cmd, int len)
{
    dfu_response_t dfu_rsp_data = {0};
    log_debug("<<< "); hexdump(cmd, len);
    dfu_write_cmd(cmd, len, &dfu_rsp_data);
    log_debug(">>> "); hexdump(&dfu_rsp_data.rsp_code, dfu_rsp_data.length);
    return dfu_rsp_data;
}
static dfu_response_t test_write_data(uint8_t *data, int len)
{
    dfu_response_t dfu_rsp_data = {0};
    //log_debug("<-- "); hexdump(data, len);
    dfu_write_data(data, len, &dfu_rsp_data);
    //if(dfu_rsp_data.length){
    //    log_debug("--> "); hexdump(&dfu_rsp_data.rsp_code, dfu_rsp_data.length);
    //}
    return dfu_rsp_data;
}

int get_file(char* filename, char** buf)
{
    if (!filename) {
        *buf = NULL;
        return 0;
    }
#define MAX_FILE_SIZE (1<<24)
    *buf = calloc(1, MAX_FILE_SIZE);
    if (!*buf) {
        log_debug("Not enough memory\n");
        return 0;
    }
    memset(*buf, 0xFF, MAX_FILE_SIZE);
    FILE* fp = fopen(filename, "rb");
    if (!fp) {
        log_debug("File %s not found\n", filename);
        return 0;
    }
    uint32_t read_size = fread(*buf, 1, MAX_FILE_SIZE, fp);
    if (read_size == MAX_FILE_SIZE) {
        log_debug("File size exceed the limit size.\n");
        fclose(fp);
        return 0;
    }
    read_size = (read_size+sizeof(uint32_t)-1) & ~(sizeof(uint32_t)-1); // firmware must be word aligned
    fclose(fp);
    return read_size;
}

#endif /* __UTILS_H__ */
